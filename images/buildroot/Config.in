## images/buildroot/configs/tinyemu_riscv64_defconfig
```kconfig
# TinyEMU RISC-V 64-bit minimal image configuration
# Reference: docs/image-build-plan-1769311563.md

# Architecture
BR2_riscv=y
BR2_RISCV_64=y
BR2_RISCV_ABI_LP64D=y
BR2_RISCV_ISA_RVC=y

# Toolchain (musl for size)
BR2_TOOLCHAIN_BUILDROOT_MUSL=y
BR2_TOOLCHAIN_BUILDROOT_CXX=n
BR2_KERNEL_HEADERS_6_6=y

# Kernel
BR2_LINUX_KERNEL=y
BR2_LINUX_KERNEL_CUSTOM_VERSION=y
BR2_LINUX_KERNEL_CUSTOM_VERSION_VALUE="6.6"
BR2_LINUX_KERNEL_USE_ARCH_DEFAULT_CONFIG=y
BR2_LINUX_KERNEL_CONFIG_FRAGMENT_FILES="$(BR2_EXTERNAL_TINYEMU_PATH)/board/tinyemu/linux.config"
BR2_LINUX_KERNEL_IMAGE_TARGET="Image"

# System
BR2_TARGET_GENERIC_HOSTNAME="tinyemu"
BR2_TARGET_GENERIC_ISSUE="TinyEMU Minimal Linux"
BR2_INIT_BUSYBOX=y
BR2_ROOTFS_DEVICE_CREATION_DYNAMIC_DEVTMPFS=y

# Root filesystem
BR2_TARGET_ROOTFS_EXT2=y
BR2_TARGET_ROOTFS_EXT2_4=y
BR2_TARGET_ROOTFS_EXT2_SIZE="64M"
BR2_TARGET_ROOTFS_EXT2_INODES=32768
BR2_TARGET_ROOTFS_EXT2_XZ=y
BR2_ROOTFS_POST_BUILD_SCRIPT="$(BR2_EXTERNAL_TINYEMU_PATH)/board/tinyemu/post-build.sh"
BR2_ROOTFS_POST_IMAGE_SCRIPT="$(BR2_EXTERNAL_TINYEMU_PATH)/board/tinyemu/post-image.sh"
BR2_ROOTFS_OVERLAY="$(BR2_EXTERNAL_TINYEMU_PATH)/board/tinyemu/rootfs-overlay"

# Packages
BR2_PACKAGE_BUSYBOX_CONFIG="$(BR2_EXTERNAL_TINYEMU_PATH)/board/tinyemu/busybox.config"
BR2_PACKAGE_LIBCURL=y
BR2_PACKAGE_LIBCURL_CURL=y
BR2_PACKAGE_LIBCURL_VERBOSE=n
BR2_PACKAGE_OPENSSL=y
BR2_PACKAGE_CA_CERTIFICATES=y

# OpenSBI firmware (replaces BBL for modern kernels)
# Generic platform discovers HTIF from device tree
BR2_TARGET_OPENSBI=y
BR2_TARGET_OPENSBI_PLAT="generic"

# Disable unnecessary features
BR2_PACKAGE_BUSYBOX_SHOW_OTHERS=y
BR2_OPTIMIZE_S=y
BR2_STRIP_strip=y
```
